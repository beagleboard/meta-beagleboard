## common-bsp/conf/layer.conf
```bitbake
# We might have a conf and classes directory, append to BBPATH
BBPATH .= ":${LAYERDIR}"

# We have a recipes directory, add to BBFILES
BBFILES += "${LAYERDIR}/recipes*/*/*.bb ${LAYERDIR}/recipes*/*/*.bbappend"

BBFILE_COLLECTIONS += "meta-beagleboard-common"
BBFILE_PATTERN_meta-beagleboard-common := "^${LAYERDIR}/"
BBFILE_PRIORITY_meta-beagleboard-common = "8"
```

## common-bsp/conf/machine/beaglebone.conf
```bitbake
#@TYPE: Machine
#@NAME: BeagleBone machine
#@DESCRIPTION: Machine configuration for the http://beagleboard.org/bone board 

PREFERRED_PROVIDER_virtual/xserver = "xserver-xorg"
XSERVER = "xserver-xorg \
           xf86-input-evdev \
           xf86-video-modesetting"

# Only has DVI connector for external screen
GUI_MACHINE_CLASS = "bigscreen"

require conf/machine/include/ti33x.inc

PREFERRED_PROVIDER_virtual/kernel = "linux-mainline"

IMAGE_FSTYPES_append = " tar.xz "

# Guesswork
SERIAL_CONSOLE = "115200 ttyO0"

UBOOT_MACHINE = "am335x_evm_config"

# and sdio
MACHINE_FEATURES = "kernel26 screen apm usbgadget usbhost vfat alsa"

MACHINE_ESSENTIAL_EXTRA_RDEPENDS = "kernel-devicetree-overlays"
```

## common-bsp/conf/machine/include/ti33x.inc
```bitbake
SOC_FAMILY = "ti33x"
require conf/machine/include/soc-family.inc

require conf/machine/include/tune-cortexa8.inc
# Increase this everytime you change something in the kernel
MACHINE_KERNEL_PR = "r19"

KERNEL_IMAGETYPE = "uImage"

UBOOT_ENTRYPOINT = "0x80008000"
UBOOT_LOADADDRESS = "0x80008000"

EXTRA_IMAGEDEPENDS += "u-boot-denx"
```

## meta-beagleboard-extras/conf/layer.conf
```bitbake
# We might have a conf and classes directory, append to BBPATH
BBPATH .= ":${LAYERDIR}"

# We have a recipes directory, add to BBFILES
BBFILES += "${LAYERDIR}/recipes*/*/*.bb ${LAYERDIR}/recipes*/*/*.bbappend"

BBFILE_COLLECTIONS += "meta-beagleboard-extras"
BBFILE_PATTERN_meta-beagleboard-extras := "^${LAYERDIR}/"
BBFILE_PRIORITY_meta-beagleboard-extras = "8"
```
